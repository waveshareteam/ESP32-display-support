## LCD-Products/ESP32-P4-NANO/ESP-IDF/3_Advanced/01_camera_dsi/sdkconfig.defaults
```kconfig
CONFIG_IDF_TARGET="esp32p4"
CONFIG_SPIRAM=y
CONFIG_IDF_EXPERIMENTAL_FEATURES=y
CONFIG_SPIRAM_SPEED_200M=y
CONFIG_CAMERA_SC2336=y
CONFIG_CAMERA_OV5647=y
CONFIG_EXAMPLE_MIPI_DSI_DISP_HRES_800=y
CONFIG_EXAMPLE_MIPI_DSI_DISP_VRES_1280=y
CONFIG_EXAMPLE_MIPI_DSI_DISP_HRES=800
CONFIG_EXAMPLE_MIPI_DSI_DISP_VRES=1280
CONFIG_EXAMPLE_MIPI_CSI_HRES_800=y
CONFIG_EXAMPLE_MIPI_CSI_DISP_HRES=800
CONFIG_EXAMPLE_MIPI_CSI_VRES_1280=y
CONFIG_EXAMPLE_MIPI_CSI_DISP_VRES=1280
```
